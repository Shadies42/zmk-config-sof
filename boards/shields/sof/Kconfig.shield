## boards/shields/sof/Kconfig.shield
```kconfig
# Copyright (c) 2020 Ryan Cross
# SPDX-License-Identifier: MIT

config SHIELD_SOF_LEFT
    def_bool $(shields_list_contains,sof_left)

config SHIELD_SOF_RIGHT
    def_bool $(shields_list_contains,sof_right)
```
